## layers/meta-balena-jetson/conf/layer.conf
```bitbake
BBPATH .= ":${LAYERDIR}"

BBFILES += "${LAYERDIR}/recipes-*/*/*.bb \
            ${LAYERDIR}/recipes-*/*/*.bbappend"

BBFILE_COLLECTIONS += "balena-jetson"
BBFILE_PATTERN_balena-jetson := "^${LAYERDIR}/"
BBFILE_PRIORITY_balena-jetson = "1337"

# kernel-image is installed by meta-tegra. We use kernel-image-initramfs
# Remove kernel-image package
MACHINE_ESSENTIAL_EXTRA_RDEPENDS:remove = "kernel-image"
MACHINE_ESSENTIAL_EXTRA_RDEPENDS:remove = "kernel-image-initramfs"
MACHINE_ESSENTIAL_EXTRA_RRECOMMENDS += "tegra-nvpmodel tegra-configs-nvstartup tegra-configs-udev"

BBMASK += "/meta-tegra/recipes-core/ "
BBMASK += "/meta-tegra/recipes-graphics/cairo "
BBMASK += "/meta-tegra/recipes-graphics/clutter "
BBMASK += "/meta-tegra/recipes-graphics/cogl "
BBMASK += "/meta-tegra/recipes-graphics/drm "
BBMASK += "/meta-tegra/recipes-graphics/mesa "
BBMASK += "/meta-tegra/recipes-graphics/vulkan "
BBMASK += "/meta-tegra/recipes-graphics/wayland "
BBMASK += "/meta-tegra/recipes-graphics/xorg-xserver "
BBMASK += "/meta-tegra/external/openembedded-layer/recipes-support/opencv/ "
BBMASK += "/meta-tegra/recipes-multimedia/gstreamer/"
BBMASK += "/meta-tegra/recipes-bsp/l4t-usb-device-mode/"
BBMASK += "/meta-tegra/recipes-graphics/xwayland"
BBMASK += "/meta-tegra/recipes-bsp/tools/tegra-boot-tools_git.bb"

LAYERSERIES_COMPAT_balena-jetson = "kirkstone"
SERIAL_CONSOLES:jetson-xavier = "115200;ttyTHS0 115200;ttyTCU0"
SERIAL_CONSOLES:jetson-tx2 = "115200;ttyS0"
SERIAL_CONSOLES:jetson-tx1 = "115200;ttyS0"
SERIAL_CONSOLES:jetson-nano = "115200;ttyS0"
SERIAL_CONSOLES:jetson-nano-emmc = "115200;ttyS0"
SERIAL_CONSOLES:jetson-nano-2gb-devkit-emmc = "115200;ttyS0"

KERNEL_IMAGETYPES = "Image"
KERNEL_IMAGETYPE = "Image"

PARTITION_TABLE_TYPE = "gpt"

# glibc does not compile with -Os, we should be aware
# of this when trying to make more space in the rootfs or
# initramfs.
#FULL_OPTIMIZATION:jetson-tx2 = "-Os -pipe ${DEBUG_FLAGS}"

# 4.9 kernel is too old for firmware compression
FIRMWARE_COMPRESSION = "0"

# Reduces the size of packages shared between the main rootfs and the initramfs.
CFLAGS:append:pn-busybox:jetson-tx2 = " -Os"
CFLAGS:append:pn-bash:jetson-tx2 = " -Os"
CFLAGS:append:pn-util-linux:jetson-tx2 = " -Os"
CFLAGS:append:pn-e2fsprogs:jetson-tx2 = " -Os"
CFLAGS:append:pn-dosfstools:jetson-tx2 = " -Os"
CFLAGS:append:pn-gptfdisk:jetson-tx2 = " -Os"
CFLAGS:append:pn-parted:jetson-tx2 = " -Os"
CFLAGS:append:pn-mtools:jetson-tx2 = " -Os"
CFLAGS:append:pn-shadow:jetson-tx2 = " -Os"
CFLAGS:append:pn-kmod:jetson-tx2 = " -Os"
CFLAGS:append:pn-xz:jetson-tx2 = " -Os"
CFLAGS:append:pn-zlib:jetson-tx2 = " -Os"
CFLAGS:append:pn-zstd:jetson-tx2 = " -Os"
CFLAGS:append:pn-openssl:jetson-tx2 = " -Os"
CFLAGS:append:pn-libcap:jetson-tx2 = " -Os"
CFLAGS:append:pn-libseccomp:jetson-tx2 = " -Os"
CFLAGS:append:pn-libxcrypt:jetson-tx2 = " -Os"
CFLAGS:append:pn-popt:jetson-tx2 = " -Os"
CFLAGS:append:pn-ncurses:jetson-tx2 = " -Os"
CFLAGS:append:pn-readline:jetson-tx2 = " -Os"
CFLAGS:append:pn-acl:jetson-tx2 = " -Os"
CFLAGS:append:pn-attr:jetson-tx2 = " -Os"
```
