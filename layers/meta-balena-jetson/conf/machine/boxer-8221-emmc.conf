## layers/meta-balena-jetson/conf/machine/boxer-8221-emmc.conf
```bitbake
#@TYPE: Machine
##@NAME: boxer-8221-emmc
##@DESCRIPTION: Machine configuration for the AAEON BOXER-8221AI eMMC

require conf/machine/jetson-nano-devkit-emmc.conf

# Remove $MACHINE which is prepended by including jetson-nano-devkit-emmc
# and fix the order of overrides
MACHINEOVERRIDES := "${@'${MACHINEOVERRIDES}'.replace(':${MACHINE}',':jetson-nano-emmc:boxer-nano:${MACHINE}')}"
```

## layers/meta-balena-jetson/conf/machine/cnx100-xavier-nx.conf
```bitbake
#@TYPE: Machine
#@NAME: Auvidea CNX100 Xavier NX
##@DESCRIPTION: Auvidea CNX100 Carrier Board for Nvidia Jetson Xavier NX (based on Auvidea JNX30)
#

MACHINEOVERRIDES = "jetson-xavier-nx-devkit-emmc:${MACHINE}"
include conf/machine/jetson-xavier-nx-devkit-emmc.conf

# work-around for https://github.com/OE4T/meta-tegra/issues/400
MACHINEOVERRIDES := "${@'${MACHINEOVERRIDES}'.replace(':${MACHINE}',':jetson-xavier-nx-devkit-emmc:${MACHINE}')}"
```

## layers/meta-balena-jetson/conf/machine/floyd-nano.conf
```bitbake
#@TYPE: Machine
##@NAME: floyd-nano
##@DESCRIPTION: Machine configuration for the Floyd Carrier Board for Nvidia Jetson Nano

MACHINEOVERRIDES = "jetson-nano-emmc:${MACHINE}"
require conf/machine/jetson-nano-emmc.conf

MACHINEOVERRIDES := "${@'${MACHINEOVERRIDES}'.replace(':${MACHINE}',':jetson-nano-emmc:${MACHINE}')}"
```

## layers/meta-balena-jetson/conf/machine/forecr-dsb-nx2-xavier-nx-emmc.conf
```bitbake
#@TYPE: Machine
#@NAME: Forecr DSBOARD NX2 eMMC
##@DESCRIPTION: Forecr DSBOARD-NX2 Carrier Board for Nvidia Jetson Xavier NX eMMC
#

MACHINEOVERRIDES = "jetson-xavier-nx-devkit-emmc:${MACHINE}"
include conf/machine/jetson-xavier-nx-devkit-emmc.conf

# work-around for https://github.com/OE4T/meta-tegra/issues/400
MACHINEOVERRIDES := "${@'${MACHINEOVERRIDES}'.replace(':${MACHINE}',':jetson-xavier-nx-devkit-emmc:${MACHINE}')}"

# Uncomment this only if the dtb needs to be rebuilt.
##KERNEL_DEVICETREE = "tegra194-p3668-dsboard-nx2-0000.dtb"
```

## layers/meta-balena-jetson/conf/machine/forecr-dsboard-nx2.conf
```bitbake
#@TYPE: Machine
#@NAME: Forecr DSBOARD-NX2
#@DESCRIPTION: Industrial Carrier Board for 
#              NVIDIA® Jetson™ Nano™ & Jetson™ TX2 NX 
#              & Jetson™ Xavier™ NX 

MACHINEOVERRIDES = "jetson-xavier-nx-devkit-emmc:${MACHINE}"
include conf/machine/jetson-xavier-nx-devkit-emmc.conf
```

## layers/meta-balena-jetson/conf/machine/jetson-nano.conf
```bitbake
#@TYPE: Machine
##@NAME: jetson-nano
##@DESCRIPTION: Machine configuration for the Devkit NANO

MACHINEOVERRIDES = "jetson-nano-sqpi-sd:${MACHINE}"
include conf/machine/jetson-nano-qspi-sd.conf
```

## layers/meta-balena-jetson/conf/machine/jetson-tx2-6.conf
```bitbake
#@TYPE: Machine
##@NAME: jetson-tx2-6
##@DESCRIPTION: Machine configuration for the Jetson TX2 with configuration option 6.

MACHINEOVERRIDES = "jetson-tx2:${MACHINE}"
ODMDATA ?= "0x3090000"
include conf/machine/jetson-tx2.conf
```

## layers/meta-balena-jetson/conf/machine/jetson-xavier-nx-devkit-seeed-hat.conf
```bitbake
#@TYPE: Machine
#@NAME: jetson-xavier-nx-devkit-seeed-hat
#@DESCRIPTION: Nvidia Jetson Xavier NX SDCard Dev kit with
#              seeed hat board

MACHINEOVERRIDES = "jetson-xavier-nx-devkit:${MACHINE}"
include conf/machine/jetson-xavier-nx-devkit.conf

# work-around for https://github.com/OE4T/meta-tegra/issues/400
MACHINEOVERRIDES := "${@'${MACHINEOVERRIDES}'.replace(':${MACHINE}',':jetson-xavier-nx-devkit:${MACHINE}')}"
```

## layers/meta-balena-jetson/conf/machine/jetson-xavier-seeed-hat.conf
```bitbake
#@TYPE: Machine
#@NAME: jetson-xavier-seeed-hat
#@DESCRIPTION: Nvidia Jetson Xavier NX development kit with
#              seeed hat board

MACHINEOVERRIDES = "jetson-xavier:${MACHINE}"
include conf/machine/jetson-xavier-nx-devkit.conf
```

## layers/meta-balena-jetson/conf/machine/jn30b-nano.conf
```bitbake
#@TYPE: Machine
##@NAME: jn30b-nano
##@DESCRIPTION: Machine configuration for the Auvidea JN30B Carrier Board for Nvidia Jetson Nano

MACHINEOVERRIDES = "jetson-nano-emmc:${MACHINE}"
require conf/machine/jetson-nano-emmc.conf
```

## layers/meta-balena-jetson/conf/machine/n310-tx2.conf
```bitbake
#@TYPE: Machine
##@NAME: n310-tx2
##@DESCRIPTION: Machine configuration for the Aetina N310 carrier board for NVidia Jetson TX2

MACHINEOVERRIDES = "jetson-tx2:${MACHINE}"
ODMDATA ?= "0x7090000"
ROOTFSSIZE="28GiB"
include conf/machine/jetson-tx2.conf
```

## layers/meta-balena-jetson/conf/machine/photon-nano.conf
```bitbake
#@TYPE: Machine
##@NAME: photon-nano
##@DESCRIPTION: Machine configuration for the CTI Photon Carrier Board for Nvidia Jetson Nano

MACHINEOVERRIDES = "jetson-nano-emmc:${MACHINE}"
require conf/machine/jetson-nano-emmc.conf

MACHINEOVERRIDES := "${@'${MACHINEOVERRIDES}'.replace(':${MACHINE}',':jetson-nano-emmc:${MACHINE}')}"

# Fix for some PCIe wifi adapters that do not work with the default ASPM
# 'powersave' policy.
KERNEL_ARGS:append = " pcie_aspm.policy=performance"
```

## layers/meta-balena-jetson/conf/machine/photon-tx2-nx.conf
```bitbake
#@TYPE: Machine
#@NAME: CTI Photon TX2 NX
##@DESCRIPTION: CTI Photon Carrier Board for NVIDIA Jetson TX2 NX
#

MACHINEOVERRIDES = "jetson-tx2-nx-devkit:${MACHINE}"
include conf/machine/jetson-tx2-nx-devkit.conf

# work-around for https://github.com/OE4T/meta-tegra/issues/400
MACHINEOVERRIDES := "${@'${MACHINEOVERRIDES}'.replace(':${MACHINE}',':jetson-tx2-nx-devkit:${MACHINE}')}"
```

## layers/meta-balena-jetson/conf/machine/photon-xavier-nx.conf
```bitbake
#@TYPE: Machine
#@NAME: CTI Photon Xavier NX
##@DESCRIPTION: CTI Photon Carrier Board for Nvidia Jetson Xavier NX
#

MACHINEOVERRIDES = "jetson-xavier-nx-devkit-emmc:${MACHINE}"
include conf/machine/jetson-xavier-nx-devkit-emmc.conf

# work-around for https://github.com/OE4T/meta-tegra/issues/400
MACHINEOVERRIDES := "${@'${MACHINEOVERRIDES}'.replace(':${MACHINE}',':jetson-xavier-nx-devkit-emmc:${MACHINE}')}"
```

## layers/meta-balena-jetson/conf/machine/quark-nano.conf
```bitbake
#@TYPE: Machine
##@NAME: quark-nano
##@DESCRIPTION: Machine configuration for the CTI Quark Carrier Board for NVIDIA Jetson Nano

MACHINEOVERRIDES = "jetson-nano-emmc:${MACHINE}"
require conf/machine/jetson-nano-emmc.conf

MACHINEOVERRIDES := "${@'${MACHINEOVERRIDES}'.replace(':${MACHINE}',':jetson-nano-emmc:${MACHINE}')}"

# Fix for some PCIe wifi adapters that do not work with the default ASPM
# 'powersave' policy.
KERNEL_ARGS:append = " pcie_aspm.policy=performance"
```

## layers/meta-balena-jetson/conf/machine/spi-jetson-nano.conf
```bitbake
#@TYPE: Machine
##@NAME: spi-jetson-nano
##@DESCRIPTION: Machine configuration for SPI support on the Carrier Dev Board for Nvdia Jetson Nano

MACHINEOVERRIDES = "jetson-nano:${MACHINE}"
include conf/machine/jetson-nano.conf
```

## layers/meta-balena-jetson/conf/machine/sprocket-tx2.conf
```bitbake
#@TYPE: Machine
##@NAME: sprocket-tx2
##@DESCRIPTION: Machine configuration for the CTI Sprocket Carrier Board for NVidia Jetson TX2

MACHINEOVERRIDES = "jetson-tx2:${MACHINE}"
include conf/machine/jetson-tx2.conf
```

## layers/meta-balena-jetson/conf/machine/srd3-tx2.conf
```bitbake
#@TYPE: Machine
##@NAME: srd3-tx2
##@DESCRIPTION: Machine configuration for the SRD3

MACHINEOVERRIDES = "jetson-tx2:${MACHINE}"
include conf/machine/jetson-tx2.conf
```
